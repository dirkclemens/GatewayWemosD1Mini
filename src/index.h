#include <Arduino.h>
// https://www.aconvert.com/image/png-to-svg/
// https://realfavicongenerator.net/
// https://github.com/me-no-dev/ESPAsyncWebServer#send-binary-content-from-progmem

const uint8_t favicon_ico_gz[] PROGMEM = {0x1F,0x8B,0x08,0x08,0xE3,0x42,0x6B,0x5F,0x00,0x03,0x4D,0x79,0x73,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0x00,0x00};
const uint8_t mask_icon_svg_gz[] PROGMEM = {0x1F,0x8B,0x08,0x08,0x2E,0x4D,0x6B,0x5F,0x00,0x03,0x73,0x61,0x66,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0x00,0x00};


const char index_html[] PROGMEM = R"=====(
<!DOCTYPE html>
<html lang="de">
<head>
  <title>MySensors Gateway</title>
  <meta charset="utf-8">
  <meta name="viewport" content="width=device-width,initial-scale=1.0,user-scalable=no">
  <link rel="shortcut icon" type="image/x-icon" href="favicon.ico">
  <link rel="mask-icon" href="mask-icon.svg" color="#0ea5e9">
  <meta name="theme-color" content="#ffffff">
  <link rel="stylesheet" href="style.css">
  <script>
  // ── Circular queue ────────────────────────────────────────────────
  function CircularQueue(n) {
    var a = new Array(n).fill(''), h = 0;
    this.push = function(v){ a[h]=v; h=(h+1)%n; };
    this.toArray = function(){
      var r=[];
      for(var i=0;i<n;i++) r.push(a[(h+i)%n]);
      return r;
    };
  }
  var Q = new CircularQueue(30);
  var cmdFilter = '';

  // ── App state ─────────────────────────────────────────────────────
  var nodeNames = {};
  var sensorState = {}; // { nodeId: { sensorId: {value,time,type} } }
  var debugLines = [], indicatorLines = [];
  var telemetryHistory = [];
  var maxLogLines = 20, maxTelemetryPoints = 60;
  var logLevel = 'info', currentTab = 'messages';

  // ── Tab navigation ────────────────────────────────────────────────
  function setTab(name) {
    currentTab = name;
    document.querySelectorAll('.page').forEach(function(el){ el.classList.remove('active'); });
    document.querySelectorAll('.tab').forEach(function(el){ el.classList.remove('active'); });
    document.getElementById('page-'+name).classList.add('active');
    document.querySelector('.tab[data-tab="'+name+'"]').classList.add('active');
    if (name === 'sensors') renderSensorPanel();
  }

  // ── Server-Sent Events ────────────────────────────────────────────
  function startEvents() {
    var es = new EventSource('/events');
    es.onopen = function() {
      var el = document.getElementById('connStatus');
      el.textContent = '● online'; el.className = 'conn-status conn-ok';
    };
    es.onerror = function(e) {
      if (e.target.readyState != EventSource.OPEN) {
        var el = document.getElementById('connStatus');
        el.textContent = '○ offline'; el.className = 'conn-status conn-err';
      }
    };
    es.addEventListener('debug',     function(e){ appendLogLine('debug',     e.data, detectLevel(e.data)); }, false);
    es.addEventListener('indicator', function(e){ appendLogLine('indicator', e.data, detectLevel(e.data)); }, false);
    es.addEventListener('info',      function(e){ document.getElementById('infoContent').innerHTML = e.data; }, false);
    es.addEventListener('clients',   function(e){ document.getElementById('gwClientsContent').innerHTML = e.data; }, false);
    es.addEventListener('led',       function(e){ document.getElementById('ledStatus').innerHTML = e.data; }, false);
    es.addEventListener('messagesjson', function(e) {
      try { handleMessage(JSON.parse(e.data)); } catch(err){ console.log('msg parse error', err); }
    }, false);
    es.addEventListener('telemetry', function(e) {
      try { var t=JSON.parse(e.data); updateBadges(t); updateChart(t); } catch(err){}
    }, false);
  }

  // ── Message handler ───────────────────────────────────────────────
  function renderMessageTable() {
    var rows = Q.toArray().filter(function(m){ return m && m.time; }).reverse();
    if (cmdFilter) {
      rows = rows.filter(function(m){ return m.cmd === cmdFilter; });
    }
    document.getElementById('msgBody').innerHTML = rows.map(function(obj){
      var lbl = obj.sender + (nodeNames[obj.sender] ? ' ('+nodeNames[obj.sender]+')' : '');
      var cmdCls = obj.cmd === 'C_SET' ? 'cmd-set' : obj.cmd === 'C_INTERNAL' ? 'cmd-int' : obj.cmd === 'C_PRESENTATION' ? 'cmd-prs' : '';
      return '<tr><td>'+obj.time+'</td><td>'+esc(lbl)+'</td><td>'+obj.sensor+
             '</td><td class="'+cmdCls+'">'+obj.cmd+'</td><td>'+obj.ack+
             '</td><td>'+esc(obj.msgtype)+'</td><td class="payload">'+esc(obj.payload||'')+'</td></tr>';
    }).join('');
  }

  function setCmdFilter(v) {
    cmdFilter = v || '';
    renderMessageTable();
  }

  function handleMessage(obj) {
    Q.push(obj);
    renderMessageTable();
    if (obj.cmd === 'C_SET') {
      var nid = String(obj.sender), sid = String(obj.sensor);
      if (!sensorState[nid]) sensorState[nid] = {};
      sensorState[nid][sid] = { value: obj.payload, time: obj.time, type: obj.msgtype };
      if (currentTab === 'sensors') renderSensorPanel();
    }
  }

  // ── Sensor panel ──────────────────────────────────────────────────
  function renderSensorPanel() {
    var nids = Object.keys(sensorState).sort(function(a,b){ return parseInt(a)-parseInt(b); });
    if (!nids.length) {
      document.getElementById('sensorPanel').innerHTML = '<p class="empty-hint">Noch keine SET-Nachrichten empfangen.</p>';
      return;
    }
    var html = '';
    nids.forEach(function(nid) {
      var name = nodeNames[nid] || ('Node ' + nid);
      var sids = Object.keys(sensorState[nid]).sort(function(a,b){ return parseInt(a)-parseInt(b); });
      html += '<div class="node-card"><div class="node-header">' +
              '<span class="node-id-badge">#'+nid+'</span>' +
              '<span class="node-name">'+esc(name)+'</span></div>' +
              '<div class="sensor-list">';
      sids.forEach(function(sid) {
        var s = sensorState[nid][sid];
        html += '<div class="sensor-row">' +
                '<span class="s-sid">'+sid+'</span>' +
                '<span class="s-type">'+esc(s.type||'')+'</span>' +
                '<span class="s-val">'+esc(s.value||'')+'</span>' +
                '<span class="s-time">'+esc(s.time||'')+'</span></div>';
      });
      html += '</div></div>';
    });
    document.getElementById('sensorPanel').innerHTML = html;
  }

  function esc(s) {
    return String(s).replace(/&/g,'&amp;').replace(/</g,'&lt;').replace(/>/g,'&gt;').replace(/"/g,'&quot;');
  }

  // ── Log lines ─────────────────────────────────────────────────────
  function detectLevel(t) {
    t = (t||'').toLowerCase();
    if (/\berror\b/.test(t) || /\bfail(?:ed|ure)?\b/.test(t) || t.indexOf('❌')>=0) return 'error';
    if (t.indexOf('warn')>=0  || t.indexOf('disconnect')>=0 || t.indexOf('❗')>=0) return 'warn';
    return 'info';
  }
  function setLogLevel(lv) {
    logLevel = lv;
    document.getElementById('logLevelLabel').textContent = lv;
    renderLogLines('debug'); renderLogLines('indicator');
  }
  function appendLogLine(target, text, level) {
    var list = target === 'debug' ? debugLines : indicatorLines;
    list.push({ ts: new Date().toLocaleTimeString(), level: level, text: text });
    if (list.length > maxLogLines) list.shift();
    renderLogLines(target);
  }
  function renderLogLines(target) {
    var list = target === 'debug' ? debugLines : indicatorLines;
    var out = [];
    list.forEach(function(l) {
      if (logLevel==='warn'  && l.level==='info')  return;
      if (logLevel==='error' && l.level!=='error') return;
      out.push('<span class="logline '+l.level+'"><span class="ts">'+l.ts+'</span> ' +
               '<span class="lv">'+l.level.toUpperCase()+'</span> ' +
               '<span class="txt">'+l.text+'</span></span>');
    });
    document.getElementById(target).innerHTML = out.join('') || '<span class="logline"><span class="txt" style="color:#475569">–</span></span>';
  }

  // ── Telemetry badges & chart ──────────────────────────────────────
  function updateBadges(t) {
    document.getElementById('wifiBadge').textContent  = 'WiFi: '+(t.wifi||'?');
    document.getElementById('rssiBadge').textContent  = 'RSSI: '+t.rssi+' dBm';
    document.getElementById('heapBadge').textContent  = 'Heap: '+t.heap;
    document.getElementById('fragBadge').textContent  = 'Frag: '+t.frag+'%';
    document.getElementById('ctrlBadge').textContent  = 'GW rx/tx: '+t.gwRx+'/'+t.gwTx;
  }
  function updateChart(t) {
    telemetryHistory.push({ heap: t.heap, frag: t.frag });
    if (telemetryHistory.length > maxTelemetryPoints) telemetryHistory.shift();
    var c = document.getElementById('diagChart'); if (!c) return;
    var ctx = c.getContext('2d'), w = c.width, h = c.height;
    ctx.clearRect(0,0,w,h); ctx.fillStyle='#fafafa'; ctx.fillRect(0,0,w,h);
    var mh = 1;
    telemetryHistory.forEach(function(p){ if(p.heap>mh) mh=p.heap; });
    var n = telemetryHistory.length, dx = n>1 ? (w-10)/(n-1) : 1;
    function line(color, fn) {
      ctx.strokeStyle=color; ctx.lineWidth=1.5; ctx.beginPath();
      telemetryHistory.forEach(function(p,i){
        var x=5+i*dx, y=h-4-fn(p)*(h-8);
        i ? ctx.lineTo(x,y) : ctx.moveTo(x,y);
      });
      ctx.stroke();
    }
    line('#0ea5e9', function(p){ return p.heap/mh; });
    line('#f59e0b', function(p){ return p.frag/100; });
    // legend
    ctx.font = '10px system-ui'; ctx.fillStyle='#0ea5e9';
    ctx.fillText('Heap', 8, 12);
    ctx.fillStyle='#f59e0b'; ctx.fillText('Frag%', 48, 12);
  }

  // ── Node names ────────────────────────────────────────────────────
  function loadNodeNames() {
    fetch('/api/node-names')
      .then(function(r){ return r.json(); })
      .then(function(d){ nodeNames=d||{}; renderNodeNamesTable(); })
      .catch(function(e){ console.log('node names failed', e); });
  }
  function renderNodeNamesTable() {
    var keys = Object.keys(nodeNames).sort(function(a,b){ return parseInt(a)-parseInt(b); });
    var html = '<table class="nodes-table"><thead><tr><th>ID</th><th>Name</th></tr></thead><tbody>';
    if (!keys.length) html += '<tr><td colspan="2" style="color:#64748b">(keine Einträge)</td></tr>';
    keys.forEach(function(k){ html += '<tr><td>'+k+'</td><td>'+esc(nodeNames[k])+'</td></tr>'; });
    document.getElementById('nodeNamesTable').innerHTML = html + '</tbody></table>';
  }
  function saveNodeName() {
    var id = document.getElementById('nodeId').value.trim();
    var name = document.getElementById('nodeName').value.trim();
    var n = parseInt(id, 10);
    if (!id || isNaN(n) || n<0 || n>255) { alert('Node ID 0–255 erforderlich.'); return; }
    fetch('/api/node-name', {
      method: 'POST',
      headers: {'Content-Type':'application/x-www-form-urlencoded'},
      body: 'id='+encodeURIComponent(n)+'&name='+encodeURIComponent(name)
    }).then(function(r){ return r.json(); })
      .then(function(r){
        if (!r.ok) { alert('Fehler: '+(r.error||'?')); return; }
        if (name) nodeNames[n]=name; else delete nodeNames[n];
        renderNodeNamesTable();
        if (currentTab === 'sensors') renderSensorPanel();
      })
      .catch(function(e){ alert('Fehler: '+e); });
  }

  // ── System actions ────────────────────────────────────────────────
  function doReboot() {
    if (!confirm('Gateway neu starten?')) return;
    fetch('/reboot', { method: 'POST' })
      .then(function(){ setTimeout(function(){ location.reload(); }, 6000); });
  }

  // ── Init ──────────────────────────────────────────────────────────
  function init() {
    setTab('messages');
    startEvents();
    loadNodeNames();
    setLogLevel('info');
  }
  </script>
</head>
<body onload="init()">

<nav id="mainNav">
  <img class="nav-logo" src='data:image/svg+xml;base64,PD94bWwgdmVyc2lvbj0iMS4wIiBlbmNvZGluZz0iVVRGLTgiPz4KPCEtLSBHZW5lcmF0ZWQgYnkgUGl4ZWxtYXRvciBQcm8gMy41LjcgLS0+Cjxzdmcgd2lkdGg9IjM0MSIgaGVpZ2h0PSIzNDEiIHZpZXdCb3g9IjAgMCAzNDEgMzQxIiB4bWxucz0iaHR0cDovL3d3dy53My5vcmcvMjAwMC9zdmciPgogICAgPGcgaWQ9IkdydXBwZSI+CiAgICAgICAgPHBhdGggaWQ9IlBmYWQiIGZpbGw9IiMzNGMzZjAiIHN0cm9rZT0ibm9uZSIgZD0iTSAxNTcuMzMzMzI4IDMuOTMzMzE5IEMgMTE3LjU5OTk5OCA3LjM5OTk5NCA4Mi4yNjY2NyAyMy4zOTk5OTQgNTQuNTMzMzMzIDUwLjQ2NjY3NSBDIDQyLjEzMzMzNSA2Mi42MDAwMDYgMzYuNzk5OTk5IDY5LjI2NjY2MyAyOC40IDgzIEMgMTYuNCAxMDIuNDY2NjYgNy4yIDEyOC40NjY2NiA0LjY2NjY2NyAxNDkuNjY2NjcyIEMgMy42IDE1OC42MDAwMDYgMy40NjY2NjcgMTg2LjYwMDAwNiA0LjUzMzMzMyAxOTAuMDY2NjY2IEMgNC45MzMzMzMgMTkxLjI2NjY2MyA1LjQ2NjY2NyAxOTUuMTMzMzMxIDYgMTk4LjYwMDAwNiBDIDguMjY2NjY2IDIxNy4xMzMzMzEgMjAuNTMzMzMzIDI0Ny4xMzMzMzEgMzMuNTk5OTk4IDI2NS45MzMzNSBDIDQyLjI2NjY2NiAyNzguMzMzMzQ0IDU4Ljc5OTk5OSAyOTUuNTMzMzI1IDcxLjMzMzMzNiAzMDQuNzMzMzM3IEMgOTAuOTMzMzM0IDMxOS4xMzMzMzEgMTE3Ljg2NjY2OSAzMzAuNzMzMzM3IDE0MiAzMzUgQyAxNTMuMzMzMzI4IDMzNyAxODMuMzMzMzI4IDMzNy45MzMzMTkgMTkwLjY2NjY3MiAzMzYuMzMzMzQ0IEMgMTkyLjM5OTk5NCAzMzYuMDY2NjgxIDE5NiAzMzUuMzk5OTk0IDE5OC42NjY2NzIgMzM1IEMgMjQ4LjkzMzMzNCAzMjcuMzk5OTk0IDI5Ni41MzMzMjUgMjkyLjIwMDAxMiAzMjAgMjQ1LjI2NjY2MyBDIDMyNS42MDAwMDYgMjM0LjA2NjY2NiAzMzIuNjY2NjU2IDIxNC40NjY2NzUgMzM0IDIwNi4zMzMzMjggQyAzMzQuMzk5OTk0IDIwMy44MDAwMDMgMzM1LjA2NjY4MSAyMDAuNzMzMzM3IDMzNS4zMzMzNDQgMTk5LjY2NjY3MiBDIDMzNi41MzMzMjUgMTk0Ljg2NjY2OSAzMzcuNzMzMzM3IDE3OS4yNjY2NjMgMzM3LjYwMDAwNiAxNjcuNTMzMzQgQyAzMzcuMjAwMDEyIDEyNC43MzMzMzcgMzE5LjQ2NjY3NSA4MyAyODguNTMzMzI1IDUyLjMzMzM0NCBDIDI2NS4wNjY2ODEgMjkgMjM2LjUzMzM0IDEzLjM5OTk5NCAyMDUuODY2NjY5IDcgQyAxOTYuNTMzMzQgNSAxOTEuNDY2NjYgNC40NjY2NzUgMTczLjMzMzMyOCAzLjI2NjY2MyBDIDE3MC44MDAwMDMgMyAxNjMuNjAwMDA2IDMuMzk5OTk0IDE1Ny4zMzMzMjggMy45MzMzMTkgWiBNIDE4Ny40NjY2NiAzMi4yMDAwMTIgQyAyMzMuNjAwMDA2IDM3LjUzMzMyNSAyNzUuMjAwMDEyIDY3LjM5OTk5NCAyOTYgMTEwLjMzMzMyOCBDIDMxNy43MzMzMzcgMTU1IDMxMy42MDAwMDYgMjA3LjM5OTk5NCAyODQuOTMzMzE5IDI0OS42NjY2NTYgQyAyNzcuODY2NjY5IDI2MC4wNjY2NSAyNjAuMTMzMzMxIDI3Ny43OTk5ODggMjUwIDI4NC42MDAwMDYgQyAyMzAuODAwMDAzIDI5Ny41MzMzMjUgMjE0IDMwNC4wNjY2NSAxODkuNDY2NjYgMzA4LjMzMzM0NCBDIDE4Mi41MzMzNCAzMDkuNTMzMzI1IDE2MC4yNjY2NjMgMzA5LjUzMzMyNSAxNTMuMzMzMzI4IDMwOC4zMzMzNDQgQyAxMzcuNjAwMDA2IDMwNS42NjY2NTYgMTM0LjY2NjY3MiAzMDUgMTI2IDMwMi4wNjY2NSBDIDEwMS4wNjY2NjYgMjkzLjUzMzMyNSA3Ny4xOTk5OTcgMjc2LjYwMDAwNiA2MS43MzMzMzQgMjU2LjQ2NjY3NSBDIDU1LjIwMDAwMSAyNDguMTk5OTk3IDU0LjUzMzMzMyAyNDcuMTMzMzMxIDQ4LjkzMzMzNCAyMzcuNTMzMzI1IEMgNDQuNjY2NjY4IDIzMC4xOTk5OTcgMzcuMzMzMzMyIDIxMi40NjY2NiAzNy4zMzMzMzIgMjA5LjM5OTk5NCBDIDM3LjMzMzMzMiAyMDcuOTMzMzM0IDM2LjY2NjY2OCAyMDYuMTk5OTk3IDM1LjczMzMzNCAyMDUuMjY2NjYzIEMgMzQuNzk5OTk5IDIwNC4zMzMzMjggMzQuNTMzMzMzIDIwMy42NjY2NzIgMzQuOTMzMzM0IDIwMy42NjY2NzIgQyAzNS40NjY2NjcgMjAzLjY2NjY3MiAzNS4zMzMzMzIgMjAxLjgwMDAwMyAzNC42NjY2NjggMTk5LjUzMzM0IEMgMzAuOTMzMzMyIDE4Ni43MzMzMzcgMzAuNzk5OTk5IDE1OC4xOTk5OTcgMzQuMjY2NjY2IDE0Mi4zMzMzMjggQyA0OS43MzMzMzQgNzEuMTMzMzMxIDExNS4xOTk5OTcgMjQuMDY2NjgxIDE4Ny40NjY2NiAzMi4yMDAwMTIgWiIvPgogICAgICAgIDxwYXRoIGlkPSJwYXRoMSIgZmlsbD0iI2Y1OWQxNCIgc3Ryb2tlPSJub25lIiBkPSJNIDIwNy4wNjY2NjYgNzkuMTMzMzMxIEMgMTkwLjY2NjY3MiA4Mi40NjY2NzUgMTc2LjkzMzMzNCA5Mi44NjY2NjkgMTcwIDEwNy4xMzMzMzEgQyAxNjYuNTMzMzQgMTE0LjA2NjY2NiAxNjYuMTMzMzMxIDExNi40NjY2NiAxNjYuMTMzMzMxIDEyNyBDIDE2Ni4xMzMzMzEgMTM2LjQ2NjY2IDE2Ni42NjY2NzIgMTQwLjMzMzMyOCAxNjguOTMzMzM0IDE0NS4zOTk5OTQgTCAxNzEuODY2NjY5IDE1MS42NjY2NzIgTCAxNjguOTMzMzM0IDE1MC4wNjY2NjYgQyAxNTYuOTMzMzM0IDE0My42NjY2NzIgMTM0LjY2NjY3MiAxNDQuNzMzMzM3IDEyMi45MzMzMzQgMTUyLjQ2NjY2IEMgMTIwLjEzMzMzMSAxNTQuMzMzMzI4IDExOS4zMzMzMzYgMTU0LjE5OTk5NyAxMTEuNTk5OTk4IDE1MC4zMzMzMjggQyA4OC44MDAwMDMgMTM5LjEzMzMzMSA2MS40NjY2NjcgMTQ4LjE5OTk5NyA0OS41OTk5OTggMTcwLjg2NjY2OSBDIDQ2LjEzMzMzNSAxNzcuMzk5OTk0IDQ2IDE3OC42MDAwMDYgNDUuNTk5OTk4IDIwMi4zMzMzMjggQyA0NS4yMDAwMDEgMjI1LjM5OTk5NCA0NS4zMzMzMzIgMjI3LjI2NjY2MyA0OCAyMzEuMzk5OTk0IEMgNTAuNzk5OTk5IDIzNS45MzMzMzQgNTcuNTk5OTk4IDIzOS42NjY2NTYgNjIuNzk5OTk5IDIzOS42NjY2NTYgQyA2Ny4xOTk5OTcgMjM5LjY2NjY1NiA3NC4yNjY2NyAyMzUuODAwMDAzIDc2LjkzMzMzNCAyMzEuOTMzMzM0IEMgNzguOTMzMzM0IDIyOC44NjY2NjkgNzkuMzMzMzM2IDIyNC43MzMzMzcgNzkuNTk5OTk4IDIwNi4zMzMzMjggQyA4MCAxODUuNjY2NjcyIDgwLjI2NjY3IDE4NC4xOTk5OTcgODMuMDY2NjY2IDE4MS4zOTk5OTQgQyA4Ny44NjY2NjkgMTc2LjczMzMzNyA5NC42NjY2NjQgMTc2Ljg2NjY2OSA5OS4zMzMzMzYgMTgxLjY2NjY3MiBDIDEwMi41MzMzMzMgMTg0Ljg2NjY2OSAxMDIuNjY2NjY0IDE4NS4zOTk5OTQgMTAyLjY2NjY2NCAyMDUuOTMzMzM0IEMgMTAyLjY2NjY2NCAyMjQuNzMzMzM3IDEwMi45MzMzMzQgMjI3LjUzMzMyNSAxMDUuMzMzMzM2IDIzMS4zOTk5OTQgQyAxMDkuODY2NjY5IDIzOC44NjY2NjkgMTIwLjI2NjY3IDI0MS42NjY2NTYgMTI3LjU5OTk5OCAyMzcuNTMzMzI1IEMgMTM2IDIzMi43MzMzMzcgMTM2LjY2NjY3MiAyMzAuNDY2Njc1IDEzNi45MzMzMzQgMjA2LjMzMzMyOCBDIDEzNy4zMzMzMjggMTg1LjI2NjY2MyAxMzcuNDY2NjYgMTg0LjMzMzMyOCAxNDAuNTMzMzQgMTgxLjI2NjY2MyBDIDE0NC45MzMzMzQgMTc2LjczMzMzNyAxNTIuODAwMDAzIDE3Ni44NjY2NjkgMTU2LjgwMDAwMyAxODEuMzk5OTk0IEMgMTU5LjMzMzMyOCAxODQuNDY2NjYgMTU5LjYwMDAwNiAxODYuMzMzMzI4IDE1OS43MzMzMzcgMjA1LjY2NjY3MiBDIDE1OS44NjY2NjkgMjI5IDE2MC45MzMzMzQgMjMyLjczMzMzNyAxNjkuMDY2NjY2IDIzNy4zOTk5OTQgQyAxNzQuMjY2NjYzIDI0MC40NjY2NzUgMTgzLjQ2NjY2IDIzOS42NjY2NTYgMTg3Ljg2NjY2OSAyMzUuODAwMDAzIEMgMTkwLjUzMzM0IDIzMy4zOTk5OTQgMTkwLjkzMzMzNCAyMzMuMzk5OTk0IDE5Ny44NjY2NjkgMjM1LjgwMDAwMyBDIDIxNy44NjY2NjkgMjQyLjMzMzM0NCAyMzguOTMzMzM0IDI0MS4xMzMzMzEgMjU2LjY2NjY1NiAyMzIuMzMzMzQ0IEMgMjc5LjMzMzM0NCAyMjEuMjY2NjYzIDI5MC4xMzMzMzEgMTk5LjUzMzM0IDI4NC42NjY2NTYgMTc2LjMzMzMyOCBDIDI4MCAxNTYuMTk5OTk3IDI2NS4zMzMzNDQgMTQ1LjY2NjY3MiAyMjYuOTMzMzM0IDEzNSBDIDIxMy40NjY2NiAxMzEuMjY2NjYzIDIwOS4zMzMzMjggMTI4LjczMzMzNyAyMDkuMzMzMzI4IDEyNC4zMzMzMjggQyAyMDkuMzMzMzI4IDExOS42NjY2NzIgMjE0LjkzMzMzNCAxMTcuMTMzMzMxIDIyMy44NjY2NjkgMTE3LjY2NjY3MiBDIDIyOS4zMzMzMjggMTE4LjA2NjY2NiAyMzMuMzMzMzI4IDExOS42NjY2NzIgMjQxLjYwMDAwNiAxMjQuNDY2NjYgQyAyNTQuMTMzMzMxIDEzMS44MDAwMDMgMjYyLjEzMzMzMSAxMzMuMjY2NjYzIDI2OS44NjY2NjkgMTI5LjY2NjY3MiBDIDI4NCAxMjIuODY2NjY5IDI4NC43OTk5ODggMTA1LjUzMzM0IDI3MS4zMzMzNDQgOTMuMTMzMzMxIEMgMjYwLjUzMzMyNSA4My4xMzMzMzEgMjQ2LjgwMDAwMyA3OC4zMzMzNDQgMjI3LjYwMDAwNiA3Ny42NjY2NTYgQyAyMjAuODAwMDAzIDc3LjUzMzMyNSAyMTEuNjAwMDA2IDc4LjA2NjY4MSAyMDcuMDY2NjY2IDc5LjEzMzMzMSBaIE0gMjE3LjQ2NjY2IDE3Ni4zMzMzMjggQyAyMzQuMjY2NjYzIDE4MC43MzMzMzcgMjM5Ljg2NjY2OSAxODMuMzk5OTk0IDI0MC44MDAwMDMgMTg3LjI2NjY2MyBDIDI0Mi42NjY2NzIgMTk0LjYwMDAwNiAyMzYuNTMzMzQgMTk5IDIyMy44NjY2NjkgMTk5IEMgMjEzLjg2NjY2OSAxOTkgMjEwLjI2NjY2MyAxOTcuNTMzMzQgMjAwLjUzMzM0IDE4OS4yNjY2NjMgQyAxOTUuNjAwMDA2IDE4NS4yNjY2NjMgMTkzLjMzMzMyOCAxODIuMzMzMzI4IDE5Mi44MDAwMDMgMTc5LjI2NjY2MyBDIDE5Mi4zOTk5OTQgMTc2Ljg2NjY2OSAxOTAuOTMzMzM0IDE3Mi43MzMzMzcgMTg5LjYwMDAwNiAxNzAuMTk5OTk3IEwgMTg3LjE5OTk5NyAxNjUuNTMzMzQgTCAxOTYuMTMzMzMxIDE2OS4yNjY2NjMgQyAyMDAuOTMzMzM0IDE3MS4yNjY2NjMgMjEwLjY2NjY3MiAxNzQuNDY2NjYgMjE3LjQ2NjY2IDE3Ni4zMzMzMjggWiIvPgogICAgPC9nPgo8L3N2Zz4K' width="32" height="32" alt="">
  <span class="nav-title">MySensors Gateway</span>
  <div class="nav-tabs">
    <button class="tab" data-tab="messages" onclick="setTab('messages')">&#128233; <span class="lbl">Messages</span></button>
    <button class="tab" data-tab="sensors"  onclick="setTab('sensors')">&#128202; <span class="lbl">Sensors</span></button>
    <button class="tab" data-tab="nodes"    onclick="setTab('nodes')">&#127991; <span class="lbl">Nodes</span></button>
    <button class="tab" data-tab="info"     onclick="setTab('info')">&#8505; <span class="lbl">Info</span></button>
    <button class="tab" data-tab="debug"    onclick="setTab('debug')">&#128295; <span class="lbl">Debug</span></button>
  </div>
  <span id="connStatus" class="conn-status conn-err">&#9675; –</span>
</nav>

<main>

  <!-- ── Messages ─────────────────────────────────────── -->
  <div id="page-messages" class="page">
    <div class="msg-controls">
      <label for="cmdFilter">CMD</label>
      <select id="cmdFilter" onchange="setCmdFilter(this.value)">
        <option value="">Alle</option>
        <option value="C_PRESENTATION">C_PRESENTATION</option>
        <option value="C_SET">C_SET</option>
        <option value="C_REQ">C_REQ</option>
        <option value="C_INTERNAL">C_INTERNAL</option>
        <option value="C_STREAM">C_STREAM</option>
      </select>
    </div>
    <div class="msg-wrap">
      <table class="msg-table">
        <thead>
          <tr>
            <th>Zeit</th><th>Node</th><th>Sensor</th>
            <th>Cmd</th><th>Ack</th><th>Typ</th><th>Payload</th>
          </tr>
        </thead>
        <tbody id="msgBody"></tbody>
      </table>
    </div>
  </div>

  <!-- ── Sensors ──────────────────────────────────────── -->
  <div id="page-sensors" class="page">
    <div id="sensorPanel" class="sensor-grid">
      <p class="empty-hint">Noch keine SET-Nachrichten empfangen.</p>
    </div>
  </div>

  <!-- ── Info ─────────────────────────────────────────── -->
  <div id="page-info" class="page">
    <div id="infoContent"></div>
    <div id="gwClientsContent"></div>
    <div class="action-row">
      <button class="btn" onclick="doReboot()">&#128260; Reboot</button>
      <a href="/reconnect" class="btn btn-secondary">&#128268; Reconnect</a>
      <a href="/sync-time" class="btn btn-secondary">&#128340; Zeit sync</a>
      <a href="/bootlog.txt" class="btn btn-secondary" target="_blank">&#128203; Bootlog</a>
      <a href="/wipe" class="btn btn-danger" onclick="return confirm('Bootlog loeschen?')">&#128465; Wipe Log</a>
    </div>
  </div>

  <!-- ── Nodes ────────────────────────────────────────── -->
  <div id="page-nodes" class="page">
    <h2 class="section-title">Node-Namen</h2>
    <div class="form-row">
      <input id="nodeId"   type="text" placeholder="ID (0-255)" style="width:100px">
      <input id="nodeName" type="text" placeholder="Name (z.B. Wohnzimmer)" style="width:210px">
      <button onclick="saveNodeName()">Speichern</button>
    </div>
    <div id="nodeNamesTable"></div>
  </div>

  <!-- ── Debug ────────────────────────────────────────── -->
  <div id="page-debug" class="page">
    <div class="badges-row">
      <span class="badge" id="wifiBadge">WiFi: ?</span>
      <span class="badge" id="rssiBadge">RSSI: ?</span>
      <span class="badge" id="heapBadge">Heap: ?</span>
      <span class="badge" id="fragBadge">Frag: ?</span>
      <span class="badge" id="ctrlBadge">GW rx/tx: ?</span>
      <span class="badge" id="ledStatus"></span>
    </div>
    <canvas id="diagChart" width="700" height="140" style="width:100%;margin-bottom:10px"></canvas>
    <div class="log-controls">
      <button class="btn btn-sm" onclick="setLogLevel('info')">All</button>
      <button class="btn btn-sm" onclick="setLogLevel('warn')">Warn+</button>
      <button class="btn btn-sm" onclick="setLogLevel('error')">Errors</button>
      <span>Log: <strong id="logLevelLabel">info</strong></span>
    </div>
    <div class="log-section">
      <div class="log-label">Debug</div>
      <div class="log-box" id="debug"></div>
    </div>
    <div class="log-section">
      <div class="log-label">Indicator</div>
      <div class="log-box" id="indicator"></div>
    </div>
  </div>

</main>
</body>
</html>
)=====";
